## CMakeLists.txt
```
# SPDX-License-Identifier: Apache-2.0

cmake_minimum_required(VERSION 3.13.1)

find_package(Zephyr REQUIRED HINTS $ENV{ZEPHYR_BASE})
project(hello_world)

set(zhci_syscalls_h ${CMAKE_CURRENT_LIST_DIR}/include/zhci_syscalls.h)
set(generated_zhci_syscalls_h ${CMAKE_CURRENT_BINARY_DIR}/generated/include/generated/_zhci_syscalls.h)
set(generated_zhci_syscalls_c ${CMAKE_CURRENT_BINARY_DIR}/generated/src/zhci_syscalls.c)

add_custom_command(
    OUTPUT
    ${generated_zhci_syscalls_h}
    ${generated_zhci_syscalls_c}
    COMMAND
    ${PYTHON_EXECUTABLE} ${CMAKE_CURRENT_LIST_DIR}/scripts/parse_syscalls.py
        --include ${CMAKE_CURRENT_LIST_DIR}/include/zhci_syscalls.h
        --header-file ${generated_zhci_syscalls_h}
        --source-file ${generated_zhci_syscalls_c}
    DEPENDS
    ${zhci_syscalls_h}
    ${CMAKE_CURRENT_LIST_DIR}/scripts/parse_syscalls.py
)
add_custom_target(zhci_syscalls DEPENDS
    ${generated_zhci_syscalls_h}
    ${generated_zhci_syscalls_c}
)

set_source_files_properties(src/kmain.c PROPERTIES COMPILE_FLAGS -DNO_POSIX_CHEATS)
set_source_files_properties(src/offload.c PROPERTIES COMPILE_FLAGS -DNO_POSIX_CHEATS)

target_sources(app PRIVATE
    ${generated_zhci_syscalls_c}
    src/kmain.c
    src/offload.c
    src/main.c
)
target_include_directories(app PRIVATE
    ${CMAKE_CURRENT_LIST_DIR}/include
    ${CMAKE_CURRENT_BINARY_DIR}/generated/include
)
target_compile_options(app PRIVATE
    -Wmissing-prototypes
)
add_dependencies(app zhci_syscalls)
```

## prj.conf
```kconfig
CONFIG_KERNEL_BIN_NAME="zhci"
CONFIG_OUTPUT_STAT=n
CONFIG_OUTPUT_DISASSEMBLY=n
CONFIG_BUILD_OUTPUT_EXE=n
CONFIG_BOARD_NATIVE_POSIX_64BIT=y

CONFIG_PRINTK=y
CONFIG_SHELL=y
CONFIG_LOG=y
CONFIG_NATIVE_UART_0_ON_STDINOUT=y

CONFIG_BT=y
CONFIG_BT_CENTRAL=y
CONFIG_BT_DEBUG_LOG=y
CONFIG_BT_SMP=y
CONFIG_BT_SHELL=y
CONFIG_BT_GATT_CLIENT=y
CONFIG_BT_USB=n
CONFIG_BT_USERCHAN=y
#CONFIG_BT_DEBUG_HCI_DRIVER=y
```

## src/main.c
```c
#include <zephyr.h>
#include <sys/printk.h>
#include <zhci_syscalls.h>
#include <app_offload.h>

void main(void)
{
	printk("Hello World! %s\n", CONFIG_BOARD);

	app_offload_handle();
}

int zhci_sc_test_impl(int a, int b) {
    printk("hello from main thread a=%d b=%d\n", a, b);
    return 0;
}
```

## include/app_offload.h
```c
#ifndef APP_OFFLOAD_H
#define APP_OFFLOAD_H

void posix_irq_offload_hw(void (*routine)(void *), void *parameter);
void app_offload_handle(void);

#endif /* APP_OFFLOAD_H */
```

## include/zhci_syscalls.h
```c
#ifndef ZHCI_SYSCALLS_H
#define ZHCI_SYSCALLS_H

#include <generated/_zhci_syscalls.h>

__zhci_syscall int zhci_sc_test(int a, int b);

#endif /* ZHCI_SYSCALLS_H */
```

## src/kmain.c
```c
#include <zephyr.h>
#include <pthread.h>
#include <string.h>
#include <init.h>
#include <malloc.h>

#ifndef NO_POSIX_CHEATS
#error "missing NO_POSIX_CHEATS"
#endif

int zhci_start(int argc, char **argv);
void zephyr_main(int argc, char **argv);

static pthread_cond_t cond_started = PTHREAD_COND_INITIALIZER;
static pthread_mutex_t mtx_started = PTHREAD_MUTEX_INITIALIZER;
static volatile bool started = false;

struct zephyr_main_args {
	int argc;
	char **argv;
};

static void *zephyr_main_thread(void *args_)
{
	const struct zephyr_main_args *args = args_;
	zephyr_main(args->argc, args->argv);

	return NULL;
}

int zhci_start(int argc, char **argv)
{
	int i;
	int ret;
	pthread_t thread;
	struct zephyr_main_args args = {
		.argc = 0,
		.argv = malloc(sizeof(*argv) * argc),
	};

	if (!args.argv) {
		return -ENOMEM;
	}

	for (i = 0; i < argc; i++) {
		args.argv[i] = strdup(argv[i]);
		if (!args.argv[i]) {
			ret = -ENOMEM;
			goto err_free_args;
		}
		args.argc++;
	}

	ret = pthread_create(&thread, NULL, zephyr_main_thread, &args);
	if (ret) {
		printk("can't create zephyr main thread: %d\n", ret);
		goto err_free_args;
	}

	pthread_mutex_lock(&mtx_started);
	while (!started) {
		pthread_cond_wait(&cond_started, &mtx_started);
	}
	pthread_mutex_unlock(&mtx_started);

	return 0;

err_free_args:
	for (i = 0; i < args.argc; i++) {
		free(args.argv[i]);
	}
	free(args.argv);
	return ret;
}

static int zhci_init(const struct device *dev)
{
	started = true;
	pthread_cond_broadcast(&cond_started);

	return 0;
}
SYS_INIT(zhci_init, POST_KERNEL, 0);
```

## src/offload.c
```c
#include <zephyr.h>
#include <pthread.h>
#include <zhci_syscalls.h>
#include <irq_ctrl.h>
#include <app_offload.h>

#ifndef NO_POSIX_CHEATS
#error "missing NO_POSIX_CHEATS"
#endif

#define OFFLOAD_HW_IRQ 10

static void (*off_hw_routine)(void *);
static void *off_hw_parameter;
static pthread_mutex_t off_hw_mtx = PTHREAD_MUTEX_INITIALIZER;
static pthread_cond_t off_hw_cond = PTHREAD_COND_INITIALIZER;
static pthread_mutex_t off_hw_condmtx = PTHREAD_MUTEX_INITIALIZER;

K_SEM_DEFINE(off_hw_sem, 0, 1);

static void offload_hw_irq_handler(const void *a)
{
	ARG_UNUSED(a);
	k_sem_give(&off_hw_sem);
}

void posix_irq_offload_hw(void (*routine)(void *), void *parameter)
{
	pthread_mutex_lock(&off_hw_mtx);
	pthread_mutex_lock(&off_hw_condmtx);

	off_hw_routine = routine;
	off_hw_parameter = parameter;

	posix_isr_declare(OFFLOAD_HW_IRQ, 0, offload_hw_irq_handler, NULL);
	posix_irq_enable(OFFLOAD_HW_IRQ);
	hw_irq_ctrl_raise_im(OFFLOAD_HW_IRQ);
	posix_irq_disable(OFFLOAD_HW_IRQ);

	while (off_hw_routine) {
		pthread_cond_wait(&off_hw_cond, &off_hw_condmtx);
	}

	pthread_mutex_unlock(&off_hw_condmtx);
	pthread_mutex_unlock(&off_hw_mtx);
}

void app_offload_handle(void)
{
	for (;;) {
		k_sem_take(&off_hw_sem, K_FOREVER);

		if (off_hw_routine) {
			off_hw_routine(off_hw_parameter);

			off_hw_routine = NULL;
			off_hw_parameter = NULL;
			pthread_cond_broadcast(&off_hw_cond);
		}
	}
}
```
